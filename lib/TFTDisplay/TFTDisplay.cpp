/********************************************************
 * TFTDisplay.cpp - ST7789 TFT 驱动库实现
 *
 * 实现原理：
 *   1. SPI + DMA 发送像素数据（40MHz）
 *   2. PSRAM 帧缓冲——先在内存中绘制，再批量发到屏幕
 *   3. 8x16 等宽字体（内置字体表）
 *
 * 硬件接线：
 *   IO40=MOSI, IO41=SCK, IO11=CS, IO39=DC, IO42=BL, IO44=RST
 *   SPI 速度：40MHz（默认），可在 initSPI() 中修改
 *
 * 【如需修改颜色模式】
 *   ST7789 支持 RGB565 / RGB666 两种模式
 *   当前用 RGB565（0x55 = 16bit/pixel）
 *   如需 RGB666（18bit）：改 COLMOD 为 0x66，并修改像素写入为 3字节/pixel
 *
 * 【如需屏幕旋转】
 *   修改 MADCTL (0x36) 参数：
 *     0x00 = 竖屏（240x320）
 *     0x60 = 横屏（320x240, 镜像）
 *     0xC0 = 横屏（320x240, 正常）
 *     0xA0 = 横屏（320x240, 翻转）
 *   注意：旋转后需同步修改 TFT_WIDTH/TFT_HEIGHT
 ********************************************************/

#include "TFTDisplay.h"
using std::swap;

// ============================================================
// 8x16 ASCII 字体表
// 每个字符 16 字节，每字节对应一行中 8 个像素
// ============================================================
static const uint8_t font8x16[][16] PROGMEM = {
    {0x00,0x00,0x00,0x00,0x00,0x00,0x00,0x00,0x00,0x00,0x00,0x00,0x00,0x00,0x00,0x00}, // ' ' (空格)
    {0x00,0x00,0x18,0x18,0x18,0x18,0x18,0x18,0x18,0x18,0x00,0x00,0x18,0x18,0x00,0x00}, // '!'
    {0x00,0x6C,0x6C,0x6C,0x6C,0x00,0x00,0x00,0x00,0x00,0x00,0x00,0x00,0x00,0x00,0x00}, // '"'
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    {0x00,0x00,0x00,0x00,0x70,0x9E,0x0C,0x00,0x00,0x00,0x00,0x00,0x00,0x00,0x00,0x00}, // '~'
};

// ============================================================
// 构造函数
// ============================================================
TFTDisplay::TFTDisplay() : _spi(nullptr), _frameBuf(nullptr), _bufSize(0), _cursorX(0), _cursorY(0) {}

// ============================================================
// 主初始化
// ============================================================
// 完整初始化序列：
//   1. initSPI() —— 初始化 SPI 总线
//   2. allocBuffer() —— 分配 PSRAM 帧缓冲
//   3. initST7789() —— 发送 ST7789 初始化命令
bool TFTDisplay::begin() {
    if (!initSPI()) return false;
    if (!allocBuffer()) return false;
    initST7789();
    return true;
}

// ============================================================
// SPI 总线初始化
// ============================================================
// 【如需修改 SPI 频率】
//   _spi->setFrequency() 改其他值
//   40MHz 是 ST7789 的典型最大速度
//   更高（80MHz）可能不稳定，更低（20MHz）兼容性更好
bool TFTDisplay::initSPI() {
    _spi = new SPIClass(HSPI);
    _spi->begin(TFT_SCK, -1, TFT_MOSI, TFT_CS);
    _spi->setFrequency(40000000);  // 40MHz SPI 时钟

    pinMode(TFT_CS, OUTPUT);
    pinMode(TFT_DC, OUTPUT);
    pinMode(TFT_BL, OUTPUT);
    pinMode(TFT_RST, OUTPUT);

    digitalWrite(TFT_BL, LOW);
    return true;
}

// ============================================================
// 帧缓冲分配
// ============================================================
// 【PSRAM 分配策略】
//   优先从 PSRAM 分配（ps_malloc）
//   如果 PSRAM 不可用，回退到内部 SRAM（malloc）
//   帧缓冲大小 = 240*320*2 = 153,600 字节
bool TFTDisplay::allocBuffer() {
    _bufSize = (uint32_t)TFT_WIDTH * TFT_HEIGHT * 2;
    _frameBuf = (uint8_t*)ps_malloc(_bufSize);
    if (!_frameBuf) {
        Serial.printf("[TFT] PSRAM fail, trying heap... ");
        _frameBuf = (uint8_t*)malloc(_bufSize);
        if (!_frameBuf) {
            Serial.println("[TFT] Buffer alloc FAILED!");
            return false;
        }
        Serial.println("OK (heap)");
    } else {
        Serial.printf("[TFT] Buffer: %u bytes (PSRAM)\n", _bufSize);
    }
    return true;
}

// ============================================================
// ST7789 初始化序列
// ============================================================
// 【如需修改初始化参数】
//   以下序列来自 ST7789V 数据手册 + 立创实战派S3调试经验
//   如需旋转屏幕：修改 MADCTL (0x36) 的值
//   如需修改显示方向：改 x/y 坐标映射
//   如需调整颜色：修改 COLMOD (0x3A) 的值
void TFTDisplay::initST7789() {
    // 硬件复位
    digitalWrite(TFT_RST, HIGH);
    delay(10);
    digitalWrite(TFT_RST, LOW);
    delay(20);
    digitalWrite(TFT_RST, HIGH);
    delay(120);

    tftCmd(TFT_SWRESET);  // 软件复位
    delay(150);
    tftCmd(TFT_SLPOUT);   // 退出休眠
    delay(500);

    // ---- 内存访问控制（屏幕旋转/镜像）----
    // 出厂默认竖屏；横屏请调用 setRotation()（见本文件顶部 setRotation 注释）
    tftCmd(TFT_MADCTL);
    tftData(0x00);  // 0x00=竖屏(240x320) —— 可被 setRotation() 覆盖
                     // 0x60=横屏(320x240, 镜像)
                     // 0xC0=横屏(320x240, 正常)
                     // 0xA0=横屏(320x240, 翻转)

    // ---- 颜色模式 ----
    // 【如需改16bit/18bit，改这里】
    tftCmd(TFT_COLMOD);
    tftData(0x55);  // 0x55 = RGB565 (16bit/pixel)
                     // 0x66 = RGB666 (18bit/pixel, 需要3字节)

    delay(10);

    // ---- 显示反色 ----
    // 立创实战派S3的 ST7789 接线导致颜色位序反转
    // 硬件上无法修复，通过 INVON 反转显示来补偿
    tftCmd(TFT_INVON);  // INVON: 显示反色开 ✅（当前使用）
                         // 如果更换屏幕后颜色正常，改为 TFT_INVOFF
    delay(10);

    // ---- Gamma 校正（默认值） ----
    // 【如需调整色彩/对比度，可以改这些 Gamma 参数】
    tftCmd(0xB2);
    tftData(0x0C); tftData(0x0C); tftData(0x00); tftData(0x33); tftData(0x33);
    tftCmd(0xB7);
    tftData(0x35);
    tftCmd(0xBB);
    tftData(0x28);  // 电源控制
    tftCmd(0xC0);
    tftData(0x2C);  // 电源控制
    tftCmd(0xC2);
    tftData(0x01);  // VDVVRHEN
    tftCmd(0xC3);
    tftData(0x0B);  // VRH
    tftCmd(0xC4);
    tftData(0x20);  // VDV
    tftCmd(0xC6);
    tftData(0x0F);  // VCOMS
    tftCmd(0xD0);
    tftData(0xA4); tftData(0xA1);  // 电源控制

    // Gamma 正极性
    tftCmd(0xE0);
    tftData(0xD0); tftData(0x04); tftData(0x0D); tftData(0x11); tftData(0x13);
    tftData(0x2B); tftData(0x3F); tftData(0x54); tftData(0x4C); tftData(0x18);
    tftData(0x0D); tftData(0x0B); tftData(0x1F); tftData(0x23);
    // Gamma 负极性
    tftCmd(0xE1);
    tftData(0xD0); tftData(0x04); tftData(0x0C); tftData(0x11); tftData(0x13);
    tftData(0x2C); tftData(0x3F); tftData(0x44); tftData(0x51); tftData(0x2F);
    tftData(0x1F); tftData(0x1F); tftData(0x20); tftData(0x23);

    // ---- 显示开启 ----
    tftCmd(TFT_DISPON);
    delay(100);
    digitalWrite(TFT_BL, HIGH);  // 打开背光

    Serial.println("[TFT] ST7789 init done!");
}

// ============================================================
// 底层 SPI 操作
// ============================================================
void TFTDisplay::tftCmd(uint8_t cmd) {
    digitalWrite(TFT_DC, LOW);   // DC=低 → 命令
    digitalWrite(TFT_CS, LOW);   // CS=低 → 选中
    _spi->transfer(cmd);
    digitalWrite(TFT_CS, HIGH);  // CS=高 → 释放
}

void TFTDisplay::tftData(uint8_t data) {
    digitalWrite(TFT_DC, HIGH);  // DC=高 → 数据
    digitalWrite(TFT_CS, LOW);
    _spi->transfer(data);
    digitalWrite(TFT_CS, HIGH);
}

void TFTDisplay::tftDataBuf(const uint8_t* buf, uint32_t len) {
    digitalWrite(TFT_DC, HIGH);  // DC=高 → 数据
    digitalWrite(TFT_CS, LOW);
    _spi->transferBytes(buf, nullptr, len);  // DMA 批量传输
    digitalWrite(TFT_CS, HIGH);
}

// ============================================================
// 屏幕方向（旋转）
// ============================================================
// 【2026-10-03 新增】原来方向写死在 initST7789() 里（0x00 竖屏）。
//   现在改成运行时切换，宽高同步跟着变，320x240 横屏也支持。
//   0x60 / 0xC0 / 0xA0 三者都是横屏，区别只在镜像与翻转方向。
void TFTDisplay::setRotation(uint8_t r) {
    uint8_t madctl;
    switch (r & 3) {
        case 0:  madctl = 0x00; _W = 240; _H = 320; break;  // 竖屏
        case 1:  madctl = 0x60; _W = 320; _H = 240; break;  // 横屏
        case 2:  madctl = 0xC0; _W = 320; _H = 240; break;  // 横屏（翻转）
        default: madctl = 0xA0; _W = 320; _H = 240; break;  // 横屏（镜像）
    }
    _rotation = r & 3;
    tftCmd(TFT_MADCTL);
    tftData(madctl);
    Serial.printf("[TFT] rotation=%u  %dx%d  MADCTL=0x%02X\n",
                  _rotation, _W, _H, madctl);
}

// ============================================================
// 设置窗口（列地址 + 行地址）
// ============================================================
// 后续写入 RAMWR 的数据会填充到此窗口内
void TFTDisplay::setWindow(int16_t x0, int16_t y0, int16_t x1, int16_t y1) {
    x0 = constrain(x0, 0, _W - 1);
    y0 = constrain(y0, 0, _H - 1);
    x1 = constrain(x1, 0, _W - 1);
    y1 = constrain(y1, 0, _H - 1);

    tftCmd(TFT_CASET);  // 列地址
    tftData(x0 >> 8); tftData(x0 & 0xFF);
    tftData(x1 >> 8); tftData(x1 & 0xFF);
    tftCmd(TFT_RASET);  // 行地址
    tftData(y0 >> 8); tftData(y0 & 0xFF);
    tftData(y1 >> 8); tftData(y1 & 0xFF);
    tftCmd(TFT_RAMWR);  // 准备写像素数据
}

// ============================================================
// 填充屏幕
// ============================================================
void TFTDisplay::fillScreen(uint16_t color) {
    fillRect(0, 0, _W, _H, color);
}

// ============================================================
// 填充矩形
// ============================================================
// 【优化说明】
//   如果有帧缓冲且区域总像素数 < 缓冲大小：
//     在缓冲中填充颜色→批量 SPI 写入
//   否则：
//     逐行填充→每行独立 SPI 发送
void TFTDisplay::fillRect(int16_t x, int16_t y, int16_t w, int16_t h, uint16_t color) {
    if (w <= 0 || h <= 0) return;
    int16_t x1 = x + w - 1;
    int16_t y1 = y + h - 1;
    uint32_t total = (uint32_t)w * h;

    setWindow(x, y, x1, y1);

    if (_frameBuf && total <= _bufSize / 2) {
        // 有帧缓冲且区域不太大：缓冲加速
        uint8_t hi = color >> 8;
        uint8_t lo = color & 0xFF;
        for (uint32_t i = 0; i < total; i++) {
            _frameBuf[i * 2]     = hi;
            _frameBuf[i * 2 + 1] = lo;
        }
        tftDataBuf(_frameBuf, total * 2);
    } else {
        // 无缓冲或区域太大：逐行写
        uint32_t rowBytes = (uint32_t)w * 2;
        uint8_t* rowBuf = (uint8_t*) malloc(rowBytes);
        if (rowBuf) {
            uint8_t hi = color >> 8;
            uint8_t lo = color & 0xFF;
            for (int i = 0; i < w; i++) {
                rowBuf[i * 2] = hi;
                rowBuf[i * 2 + 1] = lo;
            }
            for (int r = 0; r < h; r++) {
                tftDataBuf(rowBuf, rowBytes);
            }
            free(rowBuf);
        } else {
            // 最坏情况：逐像素写
            uint8_t buf[2] = {(uint8_t)(color >> 8), (uint8_t)(color & 0xFF)};
            for (uint32_t i = 0; i < total; i++) {
                tftDataBuf(buf, 2);
            }
        }
    }
}

// ============================================================
// 画点
// ============================================================
void TFTDisplay::drawPixel(int16_t x, int16_t y, uint16_t color) {
    if ((x < 0) || (x >= _W) || (y < 0) || (y >= _H)) return;
    uint8_t hi = color >> 8;
    uint8_t lo = color & 0xFF;

    setWindow(x, y, x, y);
    uint8_t buf[2] = {hi, lo};
    tftDataBuf(buf, 2);
}

// ============================================================
// 快速水平线
// ============================================================
void TFTDisplay::drawFastHLine(int16_t x, int16_t y, int16_t len, uint16_t color) {
    fillRect(x, y, len, 1, color);
}

// ============================================================
// 快速垂直线
// ============================================================
void TFTDisplay::drawFastVLine(int16_t x, int16_t y, int16_t len, uint16_t color) {
    fillRect(x, y, 1, len, color);
}

// ============================================================
// 画线（Bresenham 算法）
// ============================================================
void TFTDisplay::drawLine(int16_t x0, int16_t y0, int16_t x1, int16_t y1, uint16_t color) {
    bool steep = abs(y1 - y0) > abs(x1 - x0);
    int16_t dx = abs(x1 - x0);
    int16_t dy = abs(y1 - y0);
    int16_t err = dx - dy;
    int16_t sx = x0 < x1 ? 1 : -1;
    int16_t sy = y0 < y1 ? 1 : -1;

    while (true) {
        if (steep) {
            if (y0 >= 0 && y0 < _H && x0 >= 0 && x0 < _W) drawPixel(y0, x0, color);
        } else {
            if (x0 >= 0 && x0 < _W && y0 >= 0 && y0 < _H) drawPixel(x0, y0, color);
        }
        if (x0 == x1 && y0 == y1) break;
        int16_t e2 = 2 * err;
        if (e2 > -dy) { err -= dy; x0 += sx; }
        if (e2 < dx)  { err += dx; y0 += sy; }
    }
}

// ============================================================
// 矩形边框
// ============================================================
void TFTDisplay::drawRect(int16_t x, int16_t y, int16_t w, int16_t h, uint16_t color) {
    drawFastHLine(x, y, w, color);
    drawFastHLine(x, y + h - 1, w, color);
    drawFastVLine(x, y, h, color);
    drawFastVLine(x + w - 1, y, h, color);
}

// ============================================================
// 画圆（Bresenham 算法）
// ============================================================
void TFTDisplay::drawCircle(int16_t x, int16_t y, int16_t r, uint16_t color) {
    int16_t dx = r, dy = 0, err = 0;
    while (dx >= dy) {
        drawPixel(x + dx, y + dy, color);
        drawPixel(x + dy, y + dx, color);
        drawPixel(x - dy, y + dx, color);
        drawPixel(x - dx, y + dy, color);
        drawPixel(x - dx, y - dy, color);
        drawPixel(x - dy, y - dx, color);
        drawPixel(x + dy, y - dx, color);
        drawPixel(x + dx, y - dy, color);
        dy++;
        err += 1 + 2 * dy;
        if (2 * (err - dx) + dx > 0) { dx--; err += 1 - 2 * dx; }
    }
}

// ============================================================
// 实心圆
// ============================================================
void TFTDisplay::fillCircle(int16_t x, int16_t y, int16_t r, uint16_t color) {
    int16_t dx = 0, dy = r, err = -r, dx2, dy2;
    while (dy >= 0) {
        drawFastVLine(x - dx, y - dy, 2 * dy + 1, color);
        drawFastVLine(x + dx, y - dy, 2 * dy + 1, color);
        dy--;
        err += dy * -2 + 1;
        if (err >= 0 && y - dy <= y + dy) {
            dx++;
            err += 2 * dx + 1;
        }
    }
}

// ============================================================
// 实心三角形（健壮版：任意形状、含水平边都不会除零）
// 旧实现用 dy01/dy02/dy12 作除数，三角形一旦有水平边
// （例如状态栏的"充电闪电"）就会 IntegerDivideByZero 崩溃。
// 2026-10-03 重写。
// ============================================================
void TFTDisplay::fillTriangle(int16_t x0, int16_t y0, int16_t x1, int16_t y1,
                              int16_t x2, int16_t y2, uint16_t color) {
    // 1) 按 y 升序排序三个顶点
    if (y0 > y1) { swap(y0, y1); swap(x0, x1); }
    if (y1 > y2) { swap(y1, y2); swap(x1, x2); }
    if (y0 > y1) { swap(y0, y1); swap(x0, x1); }

    // 2) 三个点共线成水平线
    if (y0 == y2) {
        int16_t a = x0, b = x0;
        if (x1 < a) a = x1;
        if (x2 < a) a = x2;
        if (x1 > b) b = x1;
        if (x2 > b) b = x2;
        fillRect(a, y0, b - a + 1, 1, color);
        return;
    }

    // 3) 逐行扫描。左边界取长边 (x0,y0)->(x2,y2)，
    //    右边界分上段 (x0,y0)->(x1,y1) 与下段 (x1,y1)->(x2,y2)。
    //    所有除法前都判断除数是否为 0。
    for (int16_t y = y0; y <= y2; y++) {
        int32_t xa = x0 + (int32_t)(y - y0) * (x2 - x0) / (y2 - y0);

        int32_t xb;
        if (y <= y1) {
            xb = (y1 == y0) ? (int32_t)x1
                            : x0 + (int32_t)(y - y0) * (x1 - x0) / (y1 - y0);
        } else {
            xb = (y2 == y1) ? (int32_t)x1
                            : x1 + (int32_t)(y - y1) * (x2 - x1) / (y2 - y1);
        }
        if (xa > xb) { int32_t t = xa; xa = xb; xb = t; }
        drawFastHLine((int16_t)xa, y, (int16_t)(xb - xa + 1), color);
    }
}


// ============================================================
// 文字打印
// ============================================================
void TFTDisplay::setCursor(int16_t x, int16_t y) {
    _cursorX = x;
    _cursorY = y;
}

int16_t TFTDisplay::getCursorX() { return _cursorX; }
int16_t TFTDisplay::getCursorY() { return _cursorY; }

// 打印单个字符（8x16 等宽字体）
// 字符宽8像素，高16像素
// 【如需其他字体大小】
//   可以修改 font8x16 表或改用其他字体表
void TFTDisplay::printChar(char c, uint16_t fgColor, uint16_t bgColor) {
    if (c < ' ' || c > '~') c = ' ';
    uint8_t idx = c - ' ';

    for (int row = 0; row < 16; row++) {
        uint8_t line = pgm_read_byte(&font8x16[idx][row]);
        for (int col = 0; col < 8; col++) {
            uint16_t color = (line & 0x80) ? fgColor : bgColor;
            drawPixel(_cursorX + col, _cursorY + row, color);
            line <<= 1;
        }
    }
    _cursorX += 8;
    if (_cursorX > _W - 8) {
        _cursorX = 0;
        _cursorY += 16;
        if (_cursorY > _H - 16) _cursorY = 0;
    }
}

void TFTDisplay::print(const char* str, uint16_t fgColor, uint16_t bgColor) {
    while (*str) {
        printChar(*str++, fgColor, bgColor);
    }
}

void TFTDisplay::printInt(int val, uint16_t fgColor, uint16_t bgColor) {
    char buf[16];
    itoa(val, buf, 10);
    print(buf, fgColor, bgColor);
}

// ============================================================
// 背光控制
// ============================================================
// 【如需 PWM 调光】
//   可将 setBacklight() 中的 digitalWrite 改为 analogWrite
//   ESP32-S3 可用 ledcPWM（需加载 ledc 库）
void TFTDisplay::setBacklight(uint8_t brightness) {
    pinMode(TFT_BL, OUTPUT);
    if (brightness > 0) {
        digitalWrite(TFT_BL, HIGH);  // 亮
    } else {
        digitalWrite(TFT_BL, LOW);   // 灭
    }
}

// ============================================================
// 电源管理
// ============================================================
void TFTDisplay::sleep() {
    tftCmd(TFT_SLPOUT);  // 进入休眠
    delay(10);
}

void TFTDisplay::wakeup() {
    tftCmd(TFT_SLPOUT);  // 退出休眠
    delay(120);
    tftCmd(TFT_DISPON);   // 显示开启
}

// ============================================================
// RGB565 位图绘制（JPEG 解码输出用）
// ============================================================
// 【注意！】bitmap 数据必须是 RGB565 格式（主机字节序的 uint16_t 数组）。
// 字节序转换在 pushPixels() 里统一做，别在这里再换一次。
void TFTDisplay::drawRGBBitmap(int16_t x, int16_t y, const uint16_t* bitmap, int16_t w, int16_t h) {
    pushPixels(x, y, w, h, bitmap);
}

// ============================================================
// 快速像素批量写入
// 【2026-10-03 修正字节序】ST7789 16bpp 要求"高字节先发"，而 uint16_t
//   数组在 ESP32 内存里是小端（低字节在前）。原来直接把数组指针丢给
//   SPI，红蓝分量整体错位 —— 屏幕上表现就是一片彩色噪声。
//   现在逐块交换字节后再发，颜色与 drawPixel() 完全一致。
// ============================================================
void TFTDisplay::pushPixels(int16_t x, int16_t y, int16_t w, int16_t h, const uint16_t* data) {
    if (w <= 0 || h <= 0 || !data) return;
    setWindow(x, y, x + w - 1, y + h - 1);

    const uint32_t total = (uint32_t)w * h;
    const uint32_t CHUNK = 2048;                  // 每次 4KB，够快又不吃内存
    static uint8_t* sw = nullptr;
    if (!sw) sw = (uint8_t*)malloc(CHUNK * 2);
    if (!sw) {                                    // 分配失败：退化成逐像素
        for (uint32_t i = 0; i < total; i++) {
            uint8_t b[2] = {(uint8_t)(data[i] >> 8), (uint8_t)(data[i] & 0xFF)};
            tftDataBuf(b, 2);
        }
        return;
    }
    uint32_t done = 0;
    while (done < total) {
        const uint32_t n = (total - done) > CHUNK ? CHUNK : (total - done);
        for (uint32_t i = 0; i < n; i++) {
            const uint16_t v = data[done + i];
            sw[i * 2]     = (uint8_t)(v >> 8);
            sw[i * 2 + 1] = (uint8_t)(v & 0xFF);
        }
        tftDataBuf(sw, n * 2);
        done += n;
    }
}

// ============================================================
// 帧缓冲管理
// ============================================================
// 【内存使用场景】
//   下载图片前：freeBuffer() → 释放 153KB 用于下载缓冲
//   显示图片后：reallocBuffer() → 重新分配帧缓冲用于绘图
void TFTDisplay::freeBuffer() {
    if (_frameBuf) {
        free(_frameBuf);
        _frameBuf = nullptr;
        _bufSize = 0;
        Serial.println("[TFT] Frame buffer freed");
    }
}

bool TFTDisplay::reallocBuffer() {
    if (_frameBuf) return true;
    return allocBuffer();
}
